/*
 * 右半分（34 キー）。分割の周辺側（ペリフェラル）。
 *
 * 列は 9 本。595（SN74LVC595A）は 8 出力なので 2 個を数珠つなぎにして出力 0..8 を使う
 * （ngpios = 16）。最上段が 9 キーあるため。
 * 右半分の基板上では列 0..7 だが、キーマップ全体では列 6..13 に当たるので、
 * col-offset で 6 だけずらす。これが ZMK の分割の標準的な書き方。
 */
#include "hhkb_split.dtsi"

&default_transform {
	col-offset = <6>;
};

/* 右だけ 595 を 2 個つなぐ。数珠つなぎのぶん取りこぼしやすくなるので、
 * 速い打鍵での確認を Task C2-b の重点項目にしている。 */
&shifter {
	ngpios = <16>;
};

&kscan0 {
	col-gpios
		= <&shifter 0 GPIO_ACTIVE_HIGH>
		, <&shifter 1 GPIO_ACTIVE_HIGH>
		, <&shifter 2 GPIO_ACTIVE_HIGH>
		, <&shifter 3 GPIO_ACTIVE_HIGH>
		, <&shifter 4 GPIO_ACTIVE_HIGH>
		, <&shifter 5 GPIO_ACTIVE_HIGH>
		, <&shifter 6 GPIO_ACTIVE_HIGH>
		, <&shifter 7 GPIO_ACTIVE_HIGH>
		, <&shifter 8 GPIO_ACTIVE_HIGH>
		;
};

	/*
	 * **J_DB から遠い行ほど、パッド列の外側(12番寄り)へ。**
	 * （2026-08-15・利用者の指摘で組み直した）。考え方は左基板と同じ。
	 *
	 * ⚠️ **2026-08-17 に組み直した。**それまでこの並びは**左基板と同一**で、
	 * 「逆になる」と書いておきながら実装が追随していなかった。
	 *
	 * **効く順序は「パッドの外側ほど遠い行」。**J_DB のパッド列は扇の
	 * 根元で、**外側(12番)を通る芯線が遠い行へ、内側(8番)が近い行へ**
	 * 行くと交差しない。パッドの x そのものではなく、**束の中でどれだけ
	 * 外を通るか**が効く（利用者の指摘。ROW_E(#12) は最も遠くて長い
	 * のが正しい姿で、302mm あってよい）。
	 *
	 * 行バスの y は左右で同じ（行0 62.25 … 行4 138.45）。J_DB の y は
	 * 85.375 なので、**コネクタからの距離**は
	 *   行1(81.3) 4.1 < 行2(100.35) 15.0 < 行0(62.25) 23.1
	 *   < 行3(119.4) 34.0 < 行4(138.45) 53.1
	 * 近い行から順に、内側のパッド(8→12)へ割り当てる:
	 *   行1=ROW_A(#8) / 行2=ROW_B(#9) / 行0=ROW_C(#10)
	 *   / 行3=ROW_D(#11) / 行4=ROW_E(#12)
	 *
	 * 行番号 → GPIO は ROW_LANES(D5=A/D6=B/D3=C/D2=D/D1=E) の逆引き:
	 *   行0=ROW_C=D3 / 行1=ROW_A=D5 / 行2=ROW_B=D6
	 *   / 行3=ROW_D=D2 / 行4=ROW_E=D1
	 *
	 * ⚠️ **左基板とは違う並びになる。**揃えようとしないこと。
	 * ⚠️ **ネット名(#8=ROW_A…#12=ROW_E)は左右で同じ。**動かすのは
	 * 「どのレーンがどの行に載るか」だけ（circuit.py の J_DB は共通）。
	 *
	 * ⚠️ **この向きにすると未配線が 2 本残る**（組み直す前は 0 本）。
	 * **数字が悪いほうが正しい。**前の並びは未配線 0 だったが、扇が
	 * 交差したまま通っていただけで、ROW_A が最遠の行まで斜めに降りて
	 * いた。**未配線 0 を根拠にこの並びへ戻さないこと。**
	 * 残り 2 本は ROW_D(J_DB #11 → 行3) と GND(C_U2 のパッド 2 →
	 * ベタ)。後者は ROW とは無関係で、C_U2 の位置の件。
	 */
&kscan0 {
	row-gpios
		= <&xiao_d 3 (GPIO_ACTIVE_HIGH | GPIO_PULL_DOWN)>
		, <&xiao_d 5 (GPIO_ACTIVE_HIGH | GPIO_PULL_DOWN)>
		, <&xiao_d 6 (GPIO_ACTIVE_HIGH | GPIO_PULL_DOWN)>
		, <&xiao_d 2 (GPIO_ACTIVE_HIGH | GPIO_PULL_DOWN)>
		, <&xiao_d 1 (GPIO_ACTIVE_HIGH | GPIO_PULL_DOWN)>
		;
};
