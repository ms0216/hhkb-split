/*
 * Task C2: 本番と同じ「行×列マトリクス＋キーごとにダイオード1個」を
 * 最小構成で確かめる治具。2 行 × 2 列 = 4 キー。
 *
 * 本番との違いは、列をシフトレジスタではなく MCU のピンで直接駆動している
 * ところだけ。ダイオードの向き・ゴーストの有無・同時押しといった、
 * **配線の正しさに関わる性質はすべて同じ**なので、74HC595 が手元に無くても
 * ここまでは確かめられる。シフトレジスタ自体の確認は部品が届いてから
 * proto_shift で行う。
 *
 * なぜ 2×2 なのか:
 *   ゴーストは「同じ行の 2 キー ＋ 同じ列の 1 キー」で起きるので、
 *   2 行 2 列あれば再現条件を満たす。3 行にしても新しいことは分からない。
 *   加えて 30 列 × 10 行のブレッドボードには、XIAO（本体長 21mm ＝ 約 8 列）と
 *   タクトスイッチ 6 個が並ばない。4 個なら余裕を持って配置でき、
 *   ダイオードもすべて 3 列ぶんの素直な間隔で挿せる。
 *   配置は docs/hardware/img/breadboard.svg。
 *
 * col2row = ダイオードのアノードが列側、カソード（帯）が行側。
 * 列が出力（駆動）、行が入力（プルダウン付き）。
 *
 *            列 C0 (D6)      列 C1 (D5)
 *   行 R0     a               b          ← D1
 *   行 R1     c               d          ← D2
 *
 * 行にも列にも XIAO の左列（D0〜D6）だけを使うのは、配線をすべて
 * ブレッドボードの下半分に収めるため。手持ちのタクトスイッチは
 * 「押して導通する 2 本」が 2 マスしか離れておらず、中央の溝（3 マス）を
 * またげない。スイッチが下半分に収まる以上、配線も下半分で完結させたほうが
 * 溝をまたぐジャンパが 1 本も要らず、間違いが減る。
 *
 * 本番では列はシフトレジスタから来るので、ここでどのピンを使うかは
 * 本番の割り当てとは無関係でよい。
 *
 * ゴースト試験:
 *   a・b・c を同時に押しても d が出なければ、ダイオードが抜け道を
 *   止めている＝この方式でゴーストは起きない、と確認できる。
 *   （ダイオードを省くとここで d が出る）
 */

/ {
	chosen {
		zmk,kscan = &kscan0;
	};

	kscan0: kscan_0 {
		compatible = "zmk,kscan-gpio-matrix";
		wakeup-source;
		diode-direction = "col2row";

		row-gpios
			= <&xiao_d 1 (GPIO_ACTIVE_HIGH | GPIO_PULL_DOWN)>
			, <&xiao_d 2 (GPIO_ACTIVE_HIGH | GPIO_PULL_DOWN)>
			;

		col-gpios
			= <&xiao_d 6 GPIO_ACTIVE_HIGH>
			, <&xiao_d 5 GPIO_ACTIVE_HIGH>
			;
	};
};
