## config/boards/shields/c4_txburst/Kconfig.shield
```kconfig
# シールド名はディレクトリ名と完全に一致させること。
# 一致していないとビルド時に無言で無視される。
config SHIELD_C4_TXBURST
	def_bool $(shields_list_contains,c4_txburst)
```

## config/boards/shields/hhkb_split/Kconfig.shield
```kconfig
config SHIELD_HHKB_SPLIT_LEFT
	def_bool $(shields_list_contains,hhkb_split_left)

config SHIELD_HHKB_SPLIT_RIGHT
	def_bool $(shields_list_contains,hhkb_split_right)
```

## config/boards/shields/hhkb_stick_pod/Kconfig.shield
```kconfig
# スティックポッド（K 案）。**本体のシールドに重ねて使う追加シールド**
# （build.yaml で `shield: hhkb_split_right hhkb_pod_right` のように並べる）。
#
#   hhkb_pod_right   右にポッドを付ける    … **右のファーム**に重ねる
#   hhkb_pod_remote  右にポッドが付いている … **左のファーム**に重ねる（受け口）
#   hhkb_pod_left    左にポッドを付ける    … 左のファームに重ねる
#
# ⚠️ hhkb_pod_right と hhkb_pod_remote は必ず対。片方だけだと、右は動きを
#    送っているのに左が受け口を持たない（ビルドは両方とも緑）。
config SHIELD_HHKB_POD_LEFT
	def_bool $(shields_list_contains,hhkb_pod_left)

config SHIELD_HHKB_POD_RIGHT
	def_bool $(shields_list_contains,hhkb_pod_right)

config SHIELD_HHKB_POD_REMOTE
	def_bool $(shields_list_contains,hhkb_pod_remote)
```

## config/boards/shields/proto_split/Kconfig.shield
```kconfig
# シールド名はディレクトリ名と完全に一致させること。
# 一致していないとビルド時に無言で無視される。
config SHIELD_PROTO_SPLIT_LEFT
	def_bool $(shields_list_contains,proto_split_left)

config SHIELD_PROTO_SPLIT_RIGHT
	def_bool $(shields_list_contains,proto_split_right)
```

## firmware/config/boards/shields/proto_direct/Kconfig.shield
```kconfig
# シールド名はディレクトリ名と完全に一致させること。
# 一致していないとビルド時に無言で無視される。
config SHIELD_PROTO_DIRECT
	def_bool $(shields_list_contains,proto_direct)
```

## firmware/dts/bindings/behaviors/hhkb,behavior-stick-recal.yaml
```yaml
description: |
  スティックポッドの中心を取り直すキー。引数なし。

  左右どちらのポッドにも効く（locality が GLOBAL）。ポッドの無い側では何もしない。
  **ノード名は 15 文字以内**（右へ送るときの名前欄が 16 バイト）。

compatible: "hhkb,behavior-stick-recal"

include: zero_param.yaml
```

## firmware/dts/bindings/input/hhkb,input-processor-ble-pace.yaml
```yaml
description: |
  ポインタの動きを、BLE では「1 個送って、届いてから次。その間の動きは足し算」で送る
  （firmware/src/input_ble_pointer_pace.c）。listener のいちばん最後に置く。
  CONFIG_HHKB_BLE_POINTER_PACE_ACTIVE=n（既定）では何もしない。

compatible: "hhkb,input-processor-ble-pace"

include: ip_zero_param.yaml
```

## firmware/dts/bindings/input/hhkb,input-processor-button-latch.yaml
```yaml
description: |
  指定したレイヤーのどれかが立っている間に押されたボタン（from）を、別のボタン（to）として出す。
  離しは、押したときに決めたボタンで出す（firmware/src/input_button_latch.c）。

compatible: "hhkb,input-processor-button-latch"

include: ip_zero_param.yaml

properties:
  from:
    type: int
    required: true
    description: 置き換える前のコード（INPUT_BTN_0 など）
  to:
    type: int
    required: true
    description: 置き換えた後のコード
  layers:
    type: array
    required: true
    description: |
      このどれかが立っている間の押下を置き換える。**番号で書く**（名前はキーマップの中にしか無い）。
```

## firmware/dts/bindings/input/hhkb,stick-pod.yaml
```yaml
description: |
  スティックポッド（K 案）。ATtiny1616 が I2C で読まれた瞬間だけ起きて、
  スティックの傾きとクリックを 11 バイトで返す。アドレスは 0x2A。

  親の I2C は nordic,nrf-twim・100kHz（K_SPEC §4）。ドライバが I2C を自分で
  suspend/resume するので、**CONFIG_PM_DEVICE_RUNTIME とは併用しない**。

  ⚠️ 下の値のうち「仮」と書いたものは、**スティックの実物を測っていない**
  （可動範囲・ポットの値が未実測）。docs/hardware/provisional-values.md に載せること。

compatible: "hhkb,stick-pod"

include: i2c-device.yaml

properties:
  rest-period-ms:
    type: int
    default: 250
    description: |
      「静止」の読み出し周期。4Hz。電力は周期に比例する（8Hz で 2 倍）。
      **延ばすなら stick_pod_proto.h の SP_GAP_MS（3 倍＋50ms）も直す**（ビルドで落ちる）。

  active-period-ms:
    type: int
    default: 12
    description: |
      「動作」の読み出し周期。仕様は 10〜16ms としか言っていないので 12 を既定にした（仮）。
      右では 1 回の読み出しが BLE の通知を最大 2 個作る。

  absent-period-ms:
    type: int
    default: 2000
    description: 「不在」の読み出し周期。分割リンクが切れている間の周期にも使う

  stuck-period-ms:
    type: int
    default: 2000
    description: 「固着」の読み出し周期

  active-hold-ms:
    type: int
    default: 300
    description: 中心かつ非押下がこれだけ続いたら「動作」から「静止」へ

  stuck-after-seconds:
    type: int
    default: 300
    description: |
      「動作」のままこれだけ続き、傾きが不変（±3LSB）かボタンが押されたままなら「固着」。
      **押したまま 5 分を超えるドラッグはここで切れる**。
      CONFIG_ZMK_IDLE_SLEEP_TIMEOUT より短いこと（規則 6。ビルドで落ちる）。
      ⚠️「不変 ±3LSB」は仮の規則（揺れが 3LSB を超えると固着に入らない。実測待ち）。幅は stuck-stable-lsb。

  stuck-stable-lsb:
    type: int
    default: 3
    description: |
      固着の判定で「傾きが不変」とみなす幅（±LSB・10 ビット）。**仮の値。**倒したままのスティックの読みが
      この幅を超えて揺れると、固着に入れず、ポインタが流れ続けてキーボードが眠れない（模擬の S9）。
      実物の揺れ幅をログ（中心の採用・固着の行）で見てから決める。可動範囲は約 ±300LSB なので、8 で約 0.6° ぶん。

  replay-gap-ms:
    type: int
    default: 16
    description: |
      まとめて届いた押し/離しを出す間隔。仕様（規則 5）は 16ms 以上。16 未満はビルドで落ちる。
      ホストとの接続間隔はこちらからは分からないので、決め打ち。

  dead-zone-permille:
    type: int
    default: 40
    description: 不感帯の半径。X/T の差を 1/1000 単位で（仮・未実測）

  full-scale-permille:
    type: int
    default: 300
    description: |
      これ以上倒しても速くならない半径（仮・未実測）。**スティックの可動範囲を
      測って決める。**中心採用の窓（0.5±0.2 = 200）より大きくないと、
      いっぱいに倒したまま起動したときに倒した位置を中心として採用しうる。

  max-speed:
    type: int
    default: 1200
    description: いっぱいに倒したときの速さ [カウント/秒]（仮）

  curve-exponent:
    type: int
    default: 2
    enum: [1, 2, 3]
    description: 曲線の指数。1 = 直線、2 = 二乗（小さく倒すと細かく動く）
```

## firmware/dts/bindings/sensor/hhkb,battery-alkaline.yaml
```yaml
description: |
  アルカリ乾電池（直列）を分圧で読む残量計。

  ZMK の zmk,battery-voltage-divider と配線は同じで、**% の出し方だけが違う**。
  標準はリチウムイオンの放電曲線なので、乾電池では常に 0% になる
  （docs/hardware/open-gaps.md #13）。

compatible: "hhkb,battery-alkaline"

include: base.yaml

properties:
  io-channels:
    required: true
    type: phandle-array
    description: 分圧の中点を読む ADC チャンネル

  output-ohms:
    required: true
    type: int
    description: 分圧の下側（GND 側）の抵抗値

  full-ohms:
    required: true
    type: int
    description: 分圧の合計抵抗値

  empty-millivolts:
    required: true
    type: int
    description: |
      **0% とする電池端の電圧（直列の合計）。**
      「電池が空になる電圧」ではなく「この回路が動かなくなる電圧」を入れる。
      tools/circuit.py の BATT_V_MIN（マイコン・74LVC595・マトリクス・
      ソケットの下限のうち最も厳しいもの ＋ ショットキーの Vf）が唯一の出所で、
      tools/test_firmware.py が突き合わせる。

  full-millivolts:
    required: true
    type: int
    description: |
      **100% とする電池端の電圧（直列の合計）。**新品のアルカリの開路電圧。
```

## firmware/dts/bindings/sensor/hhkb,encoder-gated.yaml
```yaml
description: |
  止まっている間に電流を流さないロータリーエンコーダ（firmware/drivers/encoder_gated.c）。
  a-gpios には「クリックで止まった位置で必ず開いている相」を、b-gpios には「境目の相」を置く。
  **b の側に外付けのプルアップ抵抗を残さない**（残すと、b が閉じて止まったとき電流が流れ続ける）。
  どちらも共通端子は GND。a-gpios には GPIO_ACTIVE_LOW | GPIO_PULL_UP を、b-gpios には
  GPIO_ACTIVE_LOW を付ける（b のプルアップはドライバが読む瞬間だけ掛ける）。

compatible: "hhkb,encoder-gated"

properties:
  a-gpios:
    type: phandle-array
    required: true
  b-gpios:
    type: phandle-array
    required: true
  steps:
    type: int
    required: true
    description: 1 回転の刻みの数（EC12PL は 24）
  invert:
    type: boolean
    description: 回す向きを逆に数える
  settle-us:
    type: int
    default: 50
    description: |
      b をプルアップしてから読むまでの待ち（割り込みの中で待つ）。内蔵 13kΩ × 配線 数十 pF なら 1µs 未満で足りる。
      b に雑音よけのコンデンサ（1000pF）を足したら 13µs の時定数になるので、50 のままでよい
```
