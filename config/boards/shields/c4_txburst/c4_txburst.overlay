/*
 * Task C4: **BLE 送信バーストの高さと長さを測るためだけの治具。**
 *
 * --------------------------------------------------------------------------
 * 何を測るか（open-gaps #44 → バルクコンデンサを消せるかの判断）
 * --------------------------------------------------------------------------
 * `tools/circuit.py` の 2 つが [暫定・未実測] で、そこに判断が乗っている:
 *
 *     BLE_TX_CURRENT = 0.015   出典なし
 *     BLE_TX_BURST   = 300e-6  **リポジトリ内で 3 通りに食い違っている**
 *                              （300µs / 1〜2ms / 3ms）
 *
 * 判定式:  降下 = I·R·(1 − exp(−t/(R·C)))   R = 9.2Ω（実測）
 *          C→0 の上界 = I·R   ← t に依存しない
 *          **I < 300mV / 9.2Ω = 32.6mA なら、バルクを消しても成立する。**
 *
 * --------------------------------------------------------------------------
 * 測り方
 * --------------------------------------------------------------------------
 *     マンガン単3×2 ─ 10Ω ─┬─ XIAO の 3V3 パッド
 *                            └─ ここの両端をオシロで見る
 *
 *   ・USB は挿さない（基板上の LDO 経由で給電されシャントを迂回する）
 *   ・バルクコンデンサは付けない（バーストを吸って見えなくなる）
 *   ・安定化電源も使わない（出力の平滑 220µF が同じことをする）
 *
 * --------------------------------------------------------------------------
 * ⚠️ この治具が proto_split と違うところ（**全部、測定を汚さないため**）
 * --------------------------------------------------------------------------
 *   1. **LED を明示的に消す**（CONFIG_HHKB_LED_FORCE_OFF）。
 *      RGB は共通アノードで 3V3 直結なので、点くとシャントに乗る。
 *      1 色 1〜2mA ＝ 測りたい 15mA と同じ桁。
 *   2. **分割にしない。**相方を探して 3.7mA 食う挙動（open-gaps #26）が
 *      入ると、何を測っているのか分からなくなる。
 *   3. **キーを持たない。**走査の電流を混ぜない。
 *   4. **UART を宣言しない。**宣言があるだけで +0.46mA 乗る（2026-08-11 実測）。
 *   5. **電池残量計も積まない。**ADC が周期的に動くと段が乗る。
 *
 * **要するに「BLE の無線だけが電流を引く状態」を作る。**
 */

/ {
	chosen {
		zmk,kscan = &kscan0;
	};

	/*
	 * **キーは配線しないが、ZMK は kscan を要求する。**
	 * `zmk,kscan-mock` は GPIO を 1 本も使わないので、**走査の電流が
	 * ゼロ**になる（kscan-gpio-direct だとプルアップに電流が流れる）。
	 *
	 * `events = <0>` で、自分からキーイベントを起こすこともしない。
	 * **1 行 1 列だけ持つのは、ZMK とこのリポジトリの検査
	 * （tools/check_zmk_config.py）が「キー位置 ≧ 1」を前提にしているため。**
	 * 物理的なスイッチは付けない。
	 */
	kscan0: kscan_0 {
		compatible = "zmk,kscan-mock";
		columns = <1>;
		rows = <1>;
		events = <0>;
	};
};
