/*
 * 左 = Shift・b ／ 右 = c・d。
 *
 * **左の 1 つ目を Shift にしてある（2026-08-09）。**
 * 当初は a・b・c・d の 4 文字だったが、それでは**確かめたいものを
 * 確かめていなかった。**
 *
 * 守りたいのは「**左 Shift ＋ 右手の文字**」（仕様の必須要件）。
 * HID のキーボードレポートでは、修飾キーは通常のキーとは**別のバイト**に
 * 載るので、文字キー同士のロールオーバーが通っても保証にならない。
 * C2 で 200kHz のファームを焼いてやり直したのと同じ形。
 *
 * この割り当ては**自分で対照実験になる**。
 *
 *   左 b だけ            → b            左は生きている
 *   左 Shift ＋ 左 b     → B            **同じ半分の中**では成立する
 *   右 c / 右 d          → c / d        分割が成立している
 *   左 Shift ＋ 右 c     → C            **これが本命。分割をまたぐ修飾**
 *
 * 3 つ目まで通って 4 つ目だけ落ちるなら、原因は分割の経路に絞れる。
 *
 * --------------------------------------------------------------------------
 * ⚠️ **[一時的] 治具の操作用に組み替えた**（2026-08-10）
 * --------------------------------------------------------------------------
 * **リセットボタンを 20 回以上押して、ボタンがへたってきた。**
 * 書き込みとボンド消しを、キー操作でできるようにする。
 *
 *   左 1  &bootloader   **左**がブートローダへ（リセット 2 回押しが不要）
 *   左 2  **&bt BT_CLR** **[2026-08-15] ホストのボンド消しに戻した。**
 *                 2026-08-11 に寝起き試験用の &kp A にしていたが、
 *                 Mac と繋がらなくなり、ボンドを消す手段が要った。
 *                 **寝起きの試験は当面できない**（左に普通のキーが無い。
 *                 ① は書き込み、② はボンド消しで、どちらも副作用が出る）。
 *   右 1  &kp C         **繋がっているかの確認用。これだけは残す**
 *   右 2  &bootloader   **右**がブートローダへ
 *
 * **`&bootloader` は押された側で実行される。**
 *   app/src/behaviors/behavior_reset.c: `.locality = BEHAVIOR_LOCALITY_EVENT_SOURCE`
 * **`&bt` は locality の指定が無いので既定の CENTRAL。**常に左で実行される
 * （ホストのプロファイルはセントラルが持つので、それが正しい）。
 *
 * **`&bt BT_CLR` は分割リンクの結合を消さない。**だから右を焼き直す必要が
 * 無くなる。`settings_reset` は全部消すので、今日はそれで往復が倍になっていた。
 *
 * **上の対照実験（Shift ＋ 右手の文字）は Task C3 で済んでいる。**
 * 必要になったらこの節を戻すこと。
 */
#include <behaviors.dtsi>
#include <dt-bindings/zmk/keys.h>
#include <dt-bindings/zmk/bt.h>   /* BT_CLR。無いと devicetree が読めない */

/ {
	keymap {
		compatible = "zmk,keymap";

		default_layer {
			bindings = <
			&bootloader &bt BT_CLR   &kp C &bootloader
			>;
		};
	};
};
